// SPDX-License-Identifier: (GPL-2.0+ OR MIT)
/*
 * Copyright (c) 2025 SiMa ai
 */

/dts-v1/;

#include "simaai-modalix.dtsi"
#include "simaai-modalix-som-common.dtsi"

/ {
	model = "SiMa.ai Modalix SoM 8Gig Board";

	memory@1000000000 {
		device_type = "memory";
		reg = <0x10 0x00000000 0x1 0xC0000000>;
	};
};
