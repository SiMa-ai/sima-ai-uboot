## arch/arm/mach-sima/Kconfig
```kconfig
if ARCH_SIMA

choice
	prompt "Davici / Modalix board select"

config TARGET_DAVINCI
	bool "ARMv8, 64bit"
	select ARM64
	select BOARD_LATE_INIT
	select GICV3
	select GICV3_SUPPORT_GIC600
	imply MULTI_DTB_FIT

config TARGET_MODALIX
	bool "ARMv8, 64bit"
	select ARM64
	select BOARD_LATE_INIT
	select GICV3
	select GICV3_SUPPORT_GIC600
	imply MULTI_DTB_FIT

endchoice

config SYS_SOC
	default "sima"

endif
```

## board/sima/davinci/Kconfig
```kconfig
if TARGET_DAVINCI

config SYS_BOARD
	default "davinci"

config SYS_VENDOR
	default "sima"

config SYS_CONFIG_NAME
	default "davinci"

endif
```

## board/sima/davinci_a65/Kconfig
```kconfig
if TARGET_DAVINCI_A65

config SYS_BOARD
	default "davinci_a65"

config SYS_VENDOR
	default "sima"

config SYS_CONFIG_NAME
	default "davinci_a65"

endif
```

## board/sima/modalix/Kconfig
```kconfig
if TARGET_MODALIX

config SYS_BOARD
	default "modalix"

config SYS_VENDOR
	default "sima"

config SYS_CONFIG_NAME
	default "modalix"

endif
```

## configs/sima_modalix_defconfig
```kconfig
CONFIG_ARM=y
CONFIG_COUNTER_FREQUENCY=25000000
CONFIG_POSITION_INDEPENDENT=y
CONFIG_ARCH_SIMA=y
CONFIG_SYS_MALLOC_LEN=0x200000
CONFIG_NR_DRAM_BANKS=1
CONFIG_ENV_SIZE=0x80000
CONFIG_DM_GPIO=y
CONFIG_DEFAULT_DEVICE_TREE="simaai-modalix-dvt"
CONFIG_SYS_PROMPT="sima$ "
CONFIG_BOOTCOUNT_BOOTLIMIT=3
CONFIG_TARGET_MODALIX=y
CONFIG_ARMV8_MULTIENTRY=y
CONFIG_SYS_LOAD_ADDR=0x00000000
CONFIG_DISTRO_DEFAULTS=y
CONFIG_FIT=y
CONFIG_FIT_SIGNATURE=y
CONFIG_FIT_VERBOSE=y
CONFIG_FIT_BEST_MATCH=y
CONFIG_LEGACY_IMAGE_FORMAT=y
# CONFIG_ARCH_FIXUP_FDT_MEMORY is not set
CONFIG_BOOTDELAY=3
CONFIG_USE_PREBOOT=y
# CONFIG_DISPLAY_CPUINFO is not set
CONFIG_SYS_CBSIZE=2048
CONFIG_SYS_PBSIZE=2048
CONFIG_CMD_MEMTEST=y
CONFIG_CMD_DFU=y
CONFIG_CMD_GPIO=y
CONFIG_CMD_GPT=y
CONFIG_CMD_GPT_RENAME=y
CONFIG_CMD_MMC=y
CONFIG_BOOTP_TFTPSERVER=y
CONFIG_BOOTP_BOOTFILENAME=y
CONFIG_CMD_DNS=y
CONFIG_CMD_UUID=y
CONFIG_CMD_EXT4_WRITE=y
CONFIG_CMD_FS_UUID=y
CONFIG_PARTITION_TYPE_GUID=y
CONFIG_ENV_OVERWRITE=y
CONFIG_ENV_IS_IN_FAT=y
CONFIG_SYS_REDUNDAND_ENVIRONMENT=y
CONFIG_ENV_FAT_DEVICE_AND_PART="0:3"
CONFIG_BOOTCOUNT_LIMIT=y
CONFIG_BOOTCOUNT_ENV=y
CONFIG_CPU=y
CONFIG_DFU_TFTP=y
CONFIG_DFU_RAM=y
CONFIG_DWAPB_GPIO=y
CONFIG_MMC_DW=y
CONFIG_MMC_SDHCI=y
CONFIG_MMC_SDHCI_ADMA=y
CONFIG_MMC_SDHCI_SIMA=y
CONFIG_OF_LIST="simaai-modalix-dvt simaai-modalix-hhhl simaai-modalix-hhhl_x16 simaai-modalix-som simaai-modalix-vdk simaai-modalix-zebu"
CONFIG_PHY_FIXED=y
CONFIG_ETH_DESIGNWARE=y
CONFIG_BAUDRATE=115200
CONFIG_SPECIFY_CONSOLE_INDEX=y
CONFIG_SYS_NS16550=y
CONFIG_SYSRESET=y
CONFIG_DESIGNWARE_WATCHDOG=y
CONFIG_WDT=y
CONFIG_LMB_MAX_REGIONS=16
CONFIG_PINCTRL=y
CONFIG_PINCTRL_SIMAAI=y
CONFIG_PINCONF=y
CONFIG_RESET_SIMAAI_SIO=y
CONFIG_DM_RESET=y
CONFIG_CLK=y
CONFIG_CLK_CCF=y
CONFIG_CLK_SIMAAI_SIO=y
CONFIG_OF_LIBFDT_OVERLAY=y
CONFIG_DWC_ETH_XGMAC=y
CONFIG_PHY_MARVELL_10G=y
CONFIG_PHY_MARVELL=y
CONFIG_NET_RANDOM_ETHADDR=y
CONFIG_DM_ETH_PHY=y
CONFIG_FS_LOADER=y
CONFIG_GPIO_HOG=y
CONFIG_DM_GPIO_LOOKUP_LABEL=y
```
